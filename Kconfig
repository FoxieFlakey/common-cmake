## Kconfig
```kconfig
# Fox: Hello ignore this line UwU
# Fox: ignore this line too *squeaaak*

menu "Build"
  config BUILD_IS_LIBRARY
    bool
    select BUILD_GENERATES_EXECUTABLE
    select BUILD_USERSPACE
  
  # BUILD_IS_KERNEL and BUILD_IS_EXECUTABLE
  # are mutually exclusive
  
  config BUILD_IS_KERNEL
    bool
    select BUILD_GENERATES_EXECUTABLE
    select BUILD_INSTALL_AS_KERNEL_EXECUTABLE
    depends on !BUILD_IS_LIBRARY
  
  config BUILD_IS_EXECUTABLE
    bool
    select BUILD_GENERATES_EXECUTABLE
    select BUILD_USERSPACE
    select BUILD_CAN_INSTALL_AS_USERSPACE_EXECUTABLE
  
  config BUILD_ALLOW_GNU_DIALECT
    bool
  
  config BUILD_NEED_CLANG_BLOCKS_SUPPORT
    bool
  
  source "buildsystem/Kconfig.kernel"
  
  # Anything below wasn't meant to be set by application
  config BUILD_GENERATES_EXECUTABLE
    bool
  config BUILD_CAN_INSTALL_AS_USERSPACE_EXECUTABLE
    bool
  config BUILD_CAN_INSTALL_AS_KERNEL_EXECUTABLE
    bool
  config BUILD_USERSPACE
    bool
    select BUILD_CAN_RELOCATE
    select CONFIG_BUILD_HAVE_CLANG_BLOCKS_SUPPORT
    select BUILD_HAVE_LLVM_ASAN
    select BUILD_HAVE_LLVM_TSAN
    select BUILD_HAVE_LLVM_MSAN
    select BUILD_HAVE_LLVM_UBSAN
    select BUILD_HAVE_LLVM_XRAY
  
  if BUILD_IS_LIBRARY
    menu "Library options"
      config BUILD_INSTALL_PKGCONFIG
        bool "Install pkgconfig file"
        default y
    endmenu
  endif
  
  config DEBUG
    bool "Enable debugging mode"
  
  config BUILD_INSTALL_HEADERS
    bool "Install development headers"
  config BUILD_INSTALL_EXECUTABLE
    bool "Install executable"
    depends on BUILD_CAN_INSTALL_AS_USERSPACE_EXECUTABLE || BUILD_CAN_INSTALL_AS_KERNEL_EXECUTABLE
  
  source "buildsystem/Kconfig.compiler"
endmenu
```

## Kconfig.compiler
```kconfig
menu "Compiler"
  config BUILD_CAN_RELOCATE
    bool
  
  config BUILD_OVERRIDE_PROJECT_FLAGS
    bool "Override *ALL* project flags (DANGEROUS)"
    help
      May cause broken binary or broken compilation
  config BUILD_OVERRIDE_CFLAGS
    string "C flags"
    depends on BUILD_OVERRIDE_PROJECT_FLAGS
  config BUILD_OVERRIDE_LDFLAGS
    string "Linker flags"
    depends on BUILD_OVERRIDE_PROJECT_FLAGS

  # These option modifies flags
  if !BUILD_OVERRIDE_PROJECT_FLAGS
    config BUILD_MAXIMUM_PERFORMANCE
      bool "Enable optimization for maximum performance"
    
    config BUILD_CFLAGS
      string "Additional C flags"
    
    config BUILD_LDFLAGS
      string "Additional linker flags"
    
    config BUILD_GENERATE_DEBUG_INFO
      bool "Generate debug info"
      default y if DEBUG

    choice
      prompt "Link Time Optimization (LTO)"
      default BUILD_LTO_NONE
      
      config BUILD_LTO_NONE
        bool "None"
      config BUILD_LTO_THIN
        bool "ThinLTO"
      config BUILD_LTO_FULL
        bool "FullLTO"
    endchoice
    
    source "buildsystem/Kconfig.sanitizer"
  endif
endmenu
```

## Kconfig.kernel
```kconfig
# Kernel related stuffs
# Sanitizers support (selected by applications)
config BUILD_KERNEL_HAVE_LLVM_TSAN
  bool
  select BUILD_HAVE_LLVM_TSAN
  depends on BUILD_IS_KERNEL
config BUILD_KERNEL_HAVE_LLVM_MSAN
  bool
  select BUILD_HAVE_LLVM_MSAN
  depends on BUILD_IS_KERNEL
config BUILD_KERNEL_HAVE_LLVM_ASAN
  bool
  select BUILD_HAVE_LLVM_ASAN
  depends on BUILD_IS_KERNEL
config BUILD_KERNEL_HAVE_LLVM_UBSAN
  bool
  select BUILD_HAVE_LLVM_UBSAN
  depends on BUILD_IS_KERNEL
config BUILD_KERNEL_HAVE_LLVM_XRAY
  bool
  select BUILD_HAVE_LLVM_XRAY
  depends on BUILD_IS_KERNEL
config BUILD_KERNEL_HAVE_CLANG_BLOCKS_SUPPORT
  bool
  select BUILD_HAVE_CLANG_BLOCKS_SUPPORT
```

## Kconfig.sanitizer
```kconfig
config BUILD_HAVE_LLVM_TSAN
  bool
config BUILD_HAVE_LLVM_MSAN
  bool
config BUILD_HAVE_LLVM_ASAN
  bool
config BUILD_HAVE_LLVM_UBSAN
  bool
config BUILD_HAVE_LLVM_XRAY
  bool

choice
  prompt "Additional sanitizer"
  optional

  config BUILD_ASAN
    bool "Enable Address Sanitizer"
    depends on BUILD_HAVE_LLVM_ASAN
  config BUILD_TSAN
    bool "Enable Thread Sanitizer" 
    depends on BUILD_HAVE_LLVM_TSAN
  config BUILD_MSAN
    bool "Enable Memory Sanitizer"
    depends on BUILD_HAVE_LLVM_MSAN
endchoice

menu "Address Sanitizer"
  depends on BUILD_ASAN

  config BUILD_ASAN_OPTS
    string "Default ASAN options"
    default "fast_unwind_on_malloc=0:detect_invalid_pointer_pairs=10:strict_string_checks=1:strict_init_order=1:check_initialization_order=1:print_stats=1:detect_stack_use_after_return=1:atexit=1" 
endmenu   

menu "Memory Sanitizer"  
  depends on BUILD_MSAN

  config BUILD_MSAN_OPTS
    string "Default MSAN options"
    default ""
endmenu

menu "Thread Sanitizer"  
  depends on BUILD_TSAN

  config BUILD_TSAN_OPTS
    string "Default TSAN options"
    default "second_deadlock_stack=1"
endmenu

config BUILD_LLVM_XRAY
  bool "Enable LLVM's XRay instrumentation"
  depends on BUILD_HAVE_LLVM_XRAY
  default n

menu "LLVM XRay"
  depends on BUILD_LLVM_XRAY

  config BUILD_LLVM_XRAY_OPTS
    string "Default XRay options"
    default "xray_mode=xray-basic:patch_premain=true:verbosity=1"
endmenu

config BUILD_UBSAN
  bool "Enable Undefined behavior Sanitizer"
  depends on BUILD_HAVE_LLVM_UBSAN
  default n

menu "Undefined Sanitizer"
  depends on BUILD_UBSAN

  config BUILD_UBSAN_OPTS
    string "Default UBSAN options"
    default "print_stacktrace=1:suppressions=suppressions/UBSan.supp"
endmenu
```
